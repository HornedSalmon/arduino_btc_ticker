#include <LEDMatrixDriver.hpp>
#include <FS.h>
#include <ESP8266WiFi.h>
#include <WiFiClientSecure.h>
#include <ArduinoJson.h>


// This sketch draw marquee text on your LED matrix using the hardware SPI driver Library by Bartosz Bielawski.
// Example written 16.06.2017 by Marko Oette, www.oette.info 

// Define the ChipSelect pin for the led matrix (Dont use the SS or MISO pin of your Arduino!)
// Other pins are arduino specific SPI pins (MOSI=DIN of the LEDMatrix and CLK) see https://www.arduino.cc/en/Reference/SPI
const uint8_t LEDMATRIX_CS_PIN = 1;

// Define LED Matrix dimensions (0-n) - eg: 32x8 = 31x7
const int LEDMATRIX_WIDTH = 56;  
const int LEDMATRIX_HEIGHT = 8;
const int LEDMATRIX_SEGMENTS = 8;

// The LEDMatrixDriver class instance
LEDMatrixDriver lmd(LEDMATRIX_SEGMENTS, LEDMATRIX_CS_PIN);

void setup() {

  //Serial.begin(115200);
  char text[] = "$1234567";
  lmd.setEnabled(true);
  lmd.setIntensity(0);   // 0 = low, 10 = high
  drawHelper(text);
    // Connects to wifi
 WiFi.begin("beefsteak", "istastyyo");
  //WiFi.begin("Beeftoad", "istastyyo");
  int loop = 0;
 // WiFi.begin("uGuest", "UberElevate!");
  while (WiFi.status() != WL_CONNECTED) {
    if (loop >= 10){
      char text[] = "WIFI ERR";
      drawHelper(text);

    }
    delay(500);
    loop ++;
    //Serial.print(".");
  }
 
//  Serial.println("");
 //Serial.println("WiFi connected");  
//  Serial.println("IP address: ");
//  Serial.println(WiFi.localIP());
//  Serial.print("Netmask: ");
//  Serial.println(WiFi.subnetMask());
//  Serial.print("Gateway: ");
//  Serial.println(WiFi.gatewayIP());
//  Serial.println(WiFi.localIP());
//  // init the display

}

int x=0, y=0;   // start top left
byte font[128][8] = {
    {0x00, 0x00, 0x00, 0x00, 0x00, 0x00, 0x00, 0x00},/// ' '
    {0x00, 0x06, 0x5F, 0x5F, 0x06, 0x00, 0x00, 0x00},/// '!'
    {0x00, 0x07, 0x07, 0x00, 0x07, 0x07, 0x00, 0x00},/// '"'
    {0x14, 0x7F, 0x7F, 0x14, 0x7F, 0x7F, 0x14, 0x00},/// '#'
    //{0x24, 0x2E, 0x6B, 0x6B, 0x3A, 0x12, 0x00, 0x00},/// '$'
    {0x00,0x0c,0x1f,0x30,0x1e,0x03,0x3e,0x0c},// correct '$'
    //{0x10,0x38,0x54,0x70,0x1c,0x54,0x38,0x10}, //'dollar'
    {0x46, 0x66, 0x30, 0x18, 0x0C, 0x66, 0x62, 0x00},/// '%'
    {0x30, 0x7A, 0x4F, 0x5D, 0x37, 0x7A, 0x48, 0x00},/// '&'
    {0x04, 0x07, 0x03, 0x00, 0x00, 0x00, 0x00, 0x00},/// '''
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    {0x3E, 0x7F, 0x41, 0x5D, 0x5D, 0x1F, 0x1E, 0x00},/// '@'
    //{0x7C, 0x7E, 0x13, 0x13, 0x7E, 0x7C, 0x00, 0x00},/// 'A'
    {0x00,0x1c,0x22,0x42,0x42,0x7e,0x42,0x42}, // A
    {0x41, 0x7F, 0x7F, 0x49, 0x49, 0x7F, 0x36, 0x00},/// 'B'
    {0x1C, 0x3E, 0x63, 0x41, 0x41, 0x63, 0x22, 0x00},/// 'C'
    {0x41, 0x7F, 0x7F, 0x41, 0x63, 0x3E, 0x1C, 0x00},/// 'D'
    //{0x41, 0x7F, 0x7F, 0x49, 0x5D, 0x41, 0x63, 0x00},/// 'E'
    {0x00,0x78,0x40,0x40,0x70,0x40,0x40,0x7c}, // E
    //{0x41, 0x7F, 0x7F, 0x49, 0x1D, 0x01, 0x03, 0x00},/// 'F'
    {0x00,0x7c,0x40,0x40,0x78,0x40,0x40,0x40}, // F
    {0x1C, 0x3E, 0x63, 0x41, 0x51, 0x73, 0x72, 0x00},/// 'G'
    {0x7F, 0x7F, 0x08, 0x08, 0x7F, 0x7F, 0x00, 0x00},/// 'H'
    //{0x00, 0x41, 0x7F, 0x7F, 0x41, 0x00, 0x00, 0x00},/// 'I'
    {0x00,0x7c,0x10,0x10,0x10,0x10,0x10,0x7e}, // I
    {0x30, 0x70, 0x40, 0x41, 0x7F, 0x3F, 0x01, 0x00},/// 'J'
    {0x41, 0x7F, 0x7F, 0x08, 0x1C, 0x77, 0x63, 0x00},/// 'K'
    {0x41, 0x7F, 0x7F, 0x41, 0x40, 0x60, 0x70, 0x00},/// 'L'
    //{0x7F, 0x7F, 0x0E, 0x1C, 0x0E, 0x7F, 0x7F, 0x00},/// 'M'
    {0x00,0x82,0xc6,0xaa,0x92,0x82,0x82,0x82}, // M
    //{0x7F, 0x7F, 0x06, 0x0C, 0x18, 0x7F, 0x7F, 0x00},/// 'N'
    {0x00,0x42,0x42,0x62,0x52,0x4a,0x46,0x42}, // N
    //{0x1C, 0x3E, 0x63, 0x41, 0x63, 0x3E, 0x1C, 0x00},/// 'O'
    {0x00,0x3c,0x42,0x42,0x42,0x42,0x44,0x38}, // O
    //{0x41, 0x7F, 0x7F, 0x49, 0x09, 0x0F, 0x06, 0x00},/// 'P'
    {0x00,0x78,0x44,0x44,0x48,0x70,0x40,0x40}, // P
    {0x1E, 0x3F, 0x21, 0x71, 0x7F, 0x5E, 0x00, 0x00},/// 'Q'
//    {0x41, 0x7F, 0x7F, 0x09, 0x19, 0x7F, 0x66, 0x00},/// 'R'
    {0x00,0x78,0x44,0x44,0x78,0x50,0x48,0x44}, // R
    {0x26, 0x6F, 0x4D, 0x59, 0x73, 0x32, 0x00, 0x00},/// 'S'
    //{0x03, 0x41, 0x7F, 0x7F, 0x41, 0x03, 0x00, 0x00},/// 'T'
    {0x00,0x7e,0x90,0x10,0x10,0x10,0x10,0x10}, // T
    {0x7F, 0x7F, 0x40, 0x40, 0x7F, 0x7F, 0x00, 0x00},/// 'U'
    {0x1F, 0x3F, 0x60, 0x60, 0x3F, 0x1F, 0x00, 0x00},/// 'V'
    //{0x7F, 0x7F, 0x30, 0x18, 0x30, 0x7F, 0x7F, 0x00},/// 'W'
    {0x80,0x82,0x82,0x92,0x92,0x92,0x94,0x78}, // different 'W'
    {0x43, 0x67, 0x3C, 0x18, 0x3C, 0x67, 0x43, 0x00},/// 'X'
    {0x07, 0x4F, 0x78, 0x78, 0x4F, 0x07, 0x00, 0x00},/// 'Y'
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    {0x02, 0x03, 0x01, 0x03, 0x02, 0x03, 0x01, 0x00},//# '~';//
    };
// This is the font definition. You can use http://gurgleapps.com/tools/matrix to create your own font or sprites.
// If you like the font feel free to use it. I created it myself and donate it to the public domain.
//byte font[95][8] = { {0,0,0,0,0,0,0,0}, // SPACE
//                     {0x10,0x18,0x18,0x18,0x18,0x00,0x18,0x18}, // EXCL
//                     {0x28,0x28,0x08,0x00,0x00,0x00,0x00,0x00}, // QUOT
//                     {0x00,0x0a,0x7f,0x14,0x28,0xfe,0x50,0x00}, // #
//                     {0x10,0x38,0x54,0x70,0x1c,0x54,0x38,0x10}, // $
//                     {0x00,0x60,0x66,0x08,0x10,0x66,0x06,0x00}, // %
//                     {0,0,0,0,0,0,0,0}, // &
//                     {0x00,0x10,0x18,0x18,0x08,0x00,0x00,0x00}, // '
//                     {0x02,0x04,0x08,0x08,0x08,0x08,0x08,0x04}, // (
//                     {0x40,0x20,0x10,0x10,0x10,0x10,0x10,0x20}, // )
//                     {0x00,0x10,0x54,0x38,0x10,0x38,0x54,0x10}, // *
//                     {0x00,0x08,0x08,0x08,0x7f,0x08,0x08,0x08}, // +
//                     {0x00,0x00,0x00,0x00,0x00,0x18,0x18,0x08}, // COMMA
//                     {0x00,0x00,0x00,0x00,0x7e,0x00,0x00,0x00}, // -
//                     {0x00,0x00,0x00,0x00,0x00,0x00,0x06,0x06}, // DOT
//                     {0x00,0x04,0x04,0x08,0x10,0x20,0x40,0x40}, // /
//                     {0x00,0x38,0x44,0x4c,0x54,0x64,0x44,0x38}, // 0
//                     {0x04,0x0c,0x14,0x24,0x04,0x04,0x04,0x04}, // 1
//                     {0x00,0x30,0x48,0x04,0x04,0x38,0x40,0x7c}, // 2
//                     {0x00,0x38,0x04,0x04,0x18,0x04,0x44,0x38}, // 3
//                     {0x00,0x04,0x0c,0x14,0x24,0x7e,0x04,0x04}, // 4
//                     {0x00,0x7c,0x40,0x40,0x78,0x04,0x04,0x38}, // 5
//                     {0x00,0x38,0x40,0x40,0x78,0x44,0x44,0x38}, // 6
//                     {0x00,0x7c,0x04,0x04,0x08,0x08,0x10,0x10}, // 7
//                     {0x00,0x3c,0x44,0x44,0x38,0x44,0x44,0x78}, // 8
//                     {0x00,0x38,0x44,0x44,0x3c,0x04,0x04,0x78}, // 9
//                     {0x00,0x18,0x18,0x00,0x00,0x18,0x18,0x00}, // :
//                     {0x00,0x18,0x18,0x00,0x00,0x18,0x18,0x08}, // ;
//                     {0x00,0x10,0x20,0x40,0x80,0x40,0x20,0x10}, // <
//                     {0x00,0x00,0x7e,0x00,0x00,0xfc,0x00,0x00}, // =
//                     {0x00,0x08,0x04,0x02,0x01,0x02,0x04,0x08}, // >
//                     {0x00,0x38,0x44,0x04,0x08,0x10,0x00,0x10}, // ?
//                     {0x00,0x30,0x48,0xba,0xba,0x84,0x78,0x00}, // @
//                     {0x00,0x1c,0x22,0x42,0x42,0x7e,0x42,0x42}, // A
//                     {0x00,0x78,0x44,0x44,0x78,0x44,0x44,0x7c}, // B
//                     {0x00,0x3c,0x44,0x40,0x40,0x40,0x44,0x7c}, // C
//                     {0x00,0x7c,0x42,0x42,0x42,0x42,0x44,0x78}, // D
//                     {0x00,0x78,0x40,0x40,0x70,0x40,0x40,0x7c}, // E
//                     {0x00,0x7c,0x40,0x40,0x78,0x40,0x40,0x40}, // F
//                     {0x00,0x3c,0x40,0x40,0x5c,0x44,0x44,0x78}, // G
//                     {0x00,0x42,0x42,0x42,0x7e,0x42,0x42,0x42}, // H
//                     {0x00,0x7c,0x10,0x10,0x10,0x10,0x10,0x7e}, // I
//                     {0x00,0x7e,0x02,0x02,0x02,0x02,0x04,0x38}, // J
//                     {0x00,0x44,0x48,0x50,0x60,0x50,0x48,0x44}, // K
//                     {0x00,0x40,0x40,0x40,0x40,0x40,0x40,0x7c}, // L
//                     {0x00,0x82,0xc6,0xaa,0x92,0x82,0x82,0x82}, // M
//                     {0x00,0x42,0x42,0x62,0x52,0x4a,0x46,0x42}, // N
//                     {0x00,0x3c,0x42,0x42,0x42,0x42,0x44,0x38}, // O
//                     {0x00,0x78,0x44,0x44,0x48,0x70,0x40,0x40}, // P
//                     {0x00,0x3c,0x42,0x42,0x52,0x4a,0x44,0x3a}, // Q
//                     {0x00,0x78,0x44,0x44,0x78,0x50,0x48,0x44}, // R
//                     {0x00,0x38,0x40,0x40,0x38,0x04,0x04,0x78}, // S
//                     {0x00,0x7e,0x90,0x10,0x10,0x10,0x10,0x10}, // T
//                     {0x00,0x42,0x42,0x42,0x42,0x42,0x42,0x3e}, // U
//                     {0x00,0x42,0x42,0x42,0x42,0x44,0x28,0x10}, // V
//                     {0x80,0x82,0x82,0x92,0x92,0x92,0x94,0x78}, // W
//                     {0x00,0x42,0x42,0x24,0x18,0x24,0x42,0x42}, // X
//                     {0x00,0x44,0x44,0x28,0x10,0x10,0x10,0x10}, // Y
//                     {0x00,0x7c,0x04,0x08,0x7c,0x20,0x40,0xfe}, // Z
//                      // (the font does not contain any lower case letters. you can add your own.)
//                  };    // {}, // 

double processJson(char *json);
static char jsonBuf[4096];
const int ANIM_DELAY = 20;
const String API_KEY = "615430de-fe63-4d4d-8fc0-4c6d66bd8a8b";
//const char* host = "pro-api.coinmarketcap.com";
const char* host = "api.coinbase.com";
// Marquee text 


//EF:9D:44:BA:1A:91:4C:42:06:B1:6A:25:71:26:58:61:BA:DA:FA:B9
void loop() 
{
  int jsonLen = 0;
  WiFiClientSecure client;
  client.setInsecure();
  if (!client.connect(host, 443)) {
    Serial.println("connection failed");
    char api_error[] = "API ERR";
    drawHelper(api_error);
    delay(7000);
    return;
  }
  else{
    //Serial.println("connection");    
  }
  //String endpoint = "/v1/cryptocurrency/quotes/latest?CMC_PRO_API_KEY=" + API_KEY + "&symbol=BTC&convert=USD";
  //client.print(String("GET ") + endpoint + " HTTP/1.1\r\n" +
  client.print(String("GET ") +"/v2/prices/BTC-USD/spot" + " HTTP/1.1\r\n" +
               "Host: " + host + "\r\n" + 
               "Connection: close\r\n\r\n");
  if (client.println() == 0) {
    Serial.println("Failed to send request");
    char api_error[] = "API ERR";
    drawHelper(api_error);
    return;
   }
     // check HTTP response
  char httpStatus[32] = {0};
  client.readBytesUntil('\r', httpStatus, sizeof(httpStatus));
  if (strcmp(httpStatus, "HTTP/1.1 200 OK") != 0) {
    Serial.print("Unexpected response: ");
    Serial.println(httpStatus);
    if (strcmp(httpStatus, "HTTP/1.1 429 rate_limit_exceeded") == 0) {
        char text[] = "TOO MANY";
        drawHelper(text);
    }
    return;
  }
    // skip HTTP headers
  while (client.connected()) {
    String line = client.readStringUntil('\n');
    Serial.println(line);
    if (line == "\r") {
      break;
    }
  }

  // skip content length
  if (client.connected()) {
    String line = client.readStringUntil('\n');
    Serial.println(line);
  }

  // get response
  String response = "";
  while (client.connected()) {
    String line = client.readStringUntil('\n');
    Serial.println(line);
    line.trim();
    if (line != "\r") {
      response += line;
    }
  }

  client.stop();
  double wtf = processJson(response);
  //dtostrf(wtf, 3, 2, bitcoin);
  char bitcoin[50];
  sprintf(bitcoin, "%.8g\n", wtf);
  char dolla[2] = "$";
 char *btc_price = {strcat(dolla, bitcoin)};
 char btc_price_char [50];
 
 strcpy(btc_price_char, btc_price);
 //strcpy(btc_price_char, "790");
 //Serial.println(btc_price_char);
 
 // Draw the text to the current position
 drawHelper(btc_price_char);
 delay(7000);
 
}
float processJson(String response){ 
  //StaticJsonBuffer<3*1024> jsonBuffer;
  //DynamicJsonDocument jsonDocument;
  StaticJsonDocument<5*1024> jsonDocument;
  DeserializationError error = deserializeJson(jsonDocument, response);
  
    // Test if parsing succeeds.
  if (error) {
    Serial.print(F("deserializeJson() failed: "));
    Serial.println(error.c_str());
    return false;
  }
  JsonObject root = jsonDocument.as<JsonObject>();
    // check API status
  JsonObject status = root["status"];
  int statusErrorCode = status["error_code"];
  if (statusErrorCode != 0) {
    String statusErrorMessage = status["error_message"];
    Serial.print("Error: ");
    Serial.println(statusErrorMessage);
  }
  JsonObject coin = root["data"];
  float price = coin["amount"];
  Serial.print("Price: $");
  Serial.print(price);
  // Extracts the data in Euros
  //String bitcoin = root["bpi"]["EUR"]["rate_float"];
  //Serial.println(bitcoin);



  //Serial.println(wtf);


 // String omg_wtf = "OMG  WTF";
 // int str_len = omg_wtf.length() + 1; 
  //char bitcoin[str_len];
  //bitcoin  = bitcoin_str.toCharArray(bitcoin, omg_wtf.length());
  //Serial.println(bitcoin);
  //Serial.println("go this far too wtf");
  return price;
  
}


/**
 * This function draws a string of the given length to the given position.
 */
void drawString(char* text, int len, int x, int y )
{
  for( int idx = 0; idx < len; idx ++ )
  {

    int c = text[idx] - 32;
        if (text[idx] == '.'){
      return;
    }
 
    // stop if char is outside visible area
    if( x + idx * 8 > LEDMATRIX_WIDTH )
      return;

    // only draw if char is visible
    if( 8 + x + idx * 8 > 0 )
      drawSprite( font[c], (x + idx * 8), y, 8, 8 );
  }
}

void drawHelper(char* text){
  int len = strlen(text);
  lmd.clear();
  drawString(text, len, 0, 0);
  lmd.display();
}
/**
 * This draws a sprite to the given position using the width and height supplied (usually 8x8)
 */
void drawSprite( byte* sprite, int x, int y, int width, int height )
{
  // The mask is used to get the column bit from the sprite row
  byte mask = B10000000;
  
  for( int iy = 0; iy < height; iy++ )
  {
    for( int ix = 0; ix < width; ix++ )
    {
      lmd.setPixel(x + ix, y + iy, (bool)(sprite[iy] & mask ));

      // shift the mask by one pixel to the right
      mask = mask >> 1;
    }

    // reset column mask
    mask = B10000000;
  }
}
